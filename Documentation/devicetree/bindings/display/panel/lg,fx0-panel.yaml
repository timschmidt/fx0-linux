## Documentation/devicetree/bindings/display/panel/lg,fx0-panel.yaml
```yaml
# SPDX-License-Identifier: (GPL-2.0-only OR BSD-2-Clause)
%YAML 1.2
---
$id: http://devicetree.org/schemas/display/panel/lg,fx0-panel.yaml#
$schema: http://devicetree.org/meta-schemas/core.yaml#

title: LG Fx0 JDI 720x1280 in-cell panel

maintainers:
  - Timothy Schmidt <timschmidt@gmail.com>

description:
  Four-lane RGB888 DSI video-mode JDI panel used by production LG Fx0
  handsets. The IO switch and the positive and negative display bias
  enables are individually controlled, in that order, before reset.

allOf:
  - $ref: panel-common.yaml#

properties:
  compatible:
    const: lg,fx0-panel

  reg:
    maxItems: 1

  vdd-supply:
    description: Main 3.1 V analogue supply.

  reset-gpios:
    maxItems: 1

  io-enable-gpios:
    maxItems: 1
    description: Active-high enable for the panel IO supply switch.

  positive-enable-gpios:
    maxItems: 1
    description: Active-high enable for the positive display bias.

  negative-enable-gpios:
    maxItems: 1
    description: Active-high enable for the negative display bias.

  backlight: true
  port: true

required:
  - compatible
  - reg
  - vdd-supply
  - reset-gpios
  - io-enable-gpios
  - positive-enable-gpios
  - negative-enable-gpios
  - backlight
  - port

additionalProperties: false

examples:
  - |
    #include <dt-bindings/gpio/gpio.h>

    dsi {
        #address-cells = <1>;
        #size-cells = <0>;

        panel@0 {
            compatible = "lg,fx0-panel";
            reg = <0>;

            vdd-supply = <&pm8226_l28>;
            reset-gpios = <&tlmm 25 GPIO_ACTIVE_LOW>;
            io-enable-gpios = <&tlmm 113 GPIO_ACTIVE_HIGH>;
            positive-enable-gpios = <&tlmm 111 GPIO_ACTIVE_HIGH>;
            negative-enable-gpios = <&tlmm 112 GPIO_ACTIVE_HIGH>;
            backlight = <&pm8226_wled>;

            port {
                endpoint {
                    remote-endpoint = <&mdss_dsi0_out>;
                };
            };
        };
    };
```

## Documentation/devicetree/bindings/interconnect/qcom,msm8226.yaml
```yaml
# SPDX-License-Identifier: (GPL-2.0-only OR BSD-2-Clause)
%YAML 1.2
---
$id: http://devicetree.org/schemas/interconnect/qcom,msm8226.yaml#
$schema: http://devicetree.org/meta-schemas/core.yaml#

title: Qualcomm MSM8226 multimedia and memory interconnects

maintainers:
  - Georgi Djakov <djakov@kernel.org>

description: |
  The MMSS NoC connects the multimedia masters to the Bus Interconnect and
  Memory Controller (BIMC). BIMC clock votes go to the RPM. The multimedia
  fabric uses clocks from the multimedia clock controller.

properties:
  compatible:
    enum:
      - qcom,msm8226-bimc
      - qcom,msm8226-mmssnoc

  reg:
    maxItems: 1

  '#interconnect-cells':
    const: 1

  clocks:
    items:
      - description: Multimedia AXI root clock
      - description: Multimedia NoC AXI branch

  clock-names:
    items:
      - const: bus
      - const: iface

required:
  - compatible
  - reg
  - '#interconnect-cells'

allOf:
  - if:
      properties:
        compatible:
          const: qcom,msm8226-mmssnoc
    then:
      required:
        - clocks
        - clock-names
    else:
      properties:
        clocks: false
        clock-names: false

additionalProperties: false
```

## Documentation/devicetree/bindings/leds/qcom,pm8941-flash-led.yaml
```yaml
# SPDX-License-Identifier: (GPL-2.0-only OR BSD-2-Clause)
%YAML 1.2
---
$id: http://devicetree.org/schemas/leds/qcom,pm8941-flash-led.yaml#
$schema: http://devicetree.org/meta-schemas/core.yaml#

title: Qualcomm PM8226 and PM8941 first-generation torch LED controller

maintainers:
  - Timothy Schmidt <timschmidt@gmail.com>

description: |
  These PMICs contain the first-generation flash LED peripheral, with type
  0x18 and subtype 1 or 2. Its register layout differs from later SPMI flash
  controllers. Torch mode programs the two output current registers together,
  in 12.5 mA steps up to 200 mA. A single logical torch is described here.

properties:
  compatible:
    oneOf:
      - const: qcom,pm8941-flash-led
      - items:
          - const: qcom,pm8226-flash-led
          - const: qcom,pm8941-flash-led

  reg:
    maxItems: 1

  vin-supply:
    description: Optional supply for the torch outputs.

  led:
    type: object
    $ref: common.yaml#
    unevaluatedProperties: false

    properties:
      led-max-microamp:
        minimum: 12500
        maximum: 200000
        description: Maximum programmed torch current for each output.

    required:
      - led-max-microamp

required:
  - compatible
  - reg
  - led

additionalProperties: false

examples:
  - |
    #include <dt-bindings/leds/common.h>

    pmic {
        #address-cells = <1>;
        #size-cells = <0>;

        led-controller@d300 {
            compatible = "qcom,pm8226-flash-led", "qcom,pm8941-flash-led";
            reg = <0xd300>;

            led {
                function = LED_FUNCTION_TORCH;
                color = <LED_COLOR_ID_WHITE>;
                led-max-microamp = <200000>;
            };
        };
    };
```

## Documentation/devicetree/bindings/media/qcom,msm8226-venus.yaml
```yaml
# SPDX-License-Identifier: (GPL-2.0-only OR BSD-2-Clause)
%YAML 1.2
---
$id: http://devicetree.org/schemas/media/qcom,msm8226-venus.yaml#
$schema: http://devicetree.org/meta-schemas/core.yaml#

title: Qualcomm MSM8226 Venus video accelerator

maintainers:
  - Stanimir Varbanov <stanimir.k.varbanov@gmail.com>
  - Vikash Garodia <quic_vgarodia@quicinc.com>

description: |
  The MSM8226 Venus IP provides video encoding and decoding. The codec
  register ranges exclude the associated IOMMU and its wrapper clock
  selector. The IOMMU supplies a non-secure context for video buffers.

properties:
  compatible:
    const: qcom,msm8226-venus

  reg:
    items:
      - description: Video bus interface (VBIF)
      - description: CPU register block, including control status and interrupts
      - description: Version register at wrapper offset 0
      - description: Wrapper registers starting at offset 8

  reg-names:
    items:
      - const: vbif
      - const: cpu
      - const: wrapper-version
      - const: wrapper

  interrupts:
    maxItems: 1

  clocks:
    items:
      - description: Codec core clock
      - description: Register interface clock
      - description: Video AXI clock

  clock-names:
    items:
      - const: core
      - const: iface
      - const: bus

  power-domains:
    maxItems: 1

  iommus:
    maxItems: 1

  memory-region:
    maxItems: 1
    description: Reserved memory for the Venus firmware image

  firmware-name:
    maxItems: 1

  interconnects:
    minItems: 1
    items:
      - description: Venus video data path to main memory
      - description: CPU access path to the Venus configuration registers

  interconnect-names:
    minItems: 1
    items:
      - const: video-mem
      - const: cpu-cfg

required:
  - compatible
  - reg
  - reg-names
  - interrupts
  - clocks
  - clock-names
  - power-domains
  - iommus
  - memory-region

allOf:
  - if:
      not:
        properties:
          status:
            const: disabled
        required:
          - status
    then:
      required:
        - interconnects
        - interconnect-names

additionalProperties: false
```

## Documentation/devicetree/bindings/power/qcom,msm8226-system-pm.yaml
```yaml
# SPDX-License-Identifier: (GPL-2.0-only OR BSD-2-Clause)
%YAML 1.2
---
$id: http://devicetree.org/schemas/power/qcom,msm8226-system-pm.yaml#
$schema: http://devicetree.org/meta-schemas/core.yaml#

title: Qualcomm MSM8226 CPU cluster system power coordination

maintainers:
  - Bjorn Andersson <andersson@kernel.org>

description: |
  MSM8226 and MSM8926 combine CPU and L2 SAW sequencers, CPR-controlled CPU
  voltage, RPM resource votes and the MPM wake controller for system power
  collapse. This child of the RPM resource service identifies the providers
  that participate in the shared cluster transition. CPU SAW and ACC blocks
  are described by the CPU nodes themselves.

properties:
  $nodename:
    const: system-sleep

  compatible:
    const: qcom,msm8226-system-pm

  qcom,cpr:
    $ref: /schemas/types.yaml#/definitions/phandle
    description: MSM8926 CPR controller for the CPU cluster.

  qcom,mpm:
    $ref: /schemas/types.yaml#/definitions/phandle
    description: Always-on MPM wake controller.

  qcom,l2-spm:
    $ref: /schemas/types.yaml#/definitions/phandle
    description: L2 SAW sequencer and shared PMIC arbiter master.

required:
  - compatible
  - qcom,cpr
  - qcom,mpm
  - qcom,l2-spm

additionalProperties: false
...
```
