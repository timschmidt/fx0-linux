## Documentation/devicetree/bindings/display/panel/lg,fx0-panel.yaml
```yaml
# SPDX-License-Identifier: (GPL-2.0-only OR BSD-2-Clause)
%YAML 1.2
---
$id: http://devicetree.org/schemas/display/panel/lg,fx0-panel.yaml#
$schema: http://devicetree.org/meta-schemas/core.yaml#

title: LG Fx0 JDI 720x1280 in-cell panel

maintainers:
  - Timothy Schmidt <timschmidt@gmail.com>

description:
  Four-lane RGB888 DSI video-mode JDI panel used by production LG Fx0
  handsets. The IO switch and the positive and negative display bias
  enables are individually controlled, in that order, before reset.

allOf:
  - $ref: panel-common.yaml#

properties:
  compatible:
    const: lg,fx0-panel

  reg:
    maxItems: 1

  vdd-supply:
    description: Main 3.1 V analogue supply.

  reset-gpios:
    maxItems: 1

  io-enable-gpios:
    maxItems: 1
    description: Active-high enable for the panel IO supply switch.

  positive-enable-gpios:
    maxItems: 1
    description: Active-high enable for the positive display bias.

  negative-enable-gpios:
    maxItems: 1
    description: Active-high enable for the negative display bias.

  backlight: true
  port: true

required:
  - compatible
  - reg
  - vdd-supply
  - reset-gpios
  - io-enable-gpios
  - positive-enable-gpios
  - negative-enable-gpios
  - backlight
  - port

additionalProperties: false
```

## Documentation/devicetree/bindings/media/i2c/sony,imx179.yaml
```yaml
# SPDX-License-Identifier: (GPL-2.0-only OR BSD-2-Clause)
%YAML 1.2
---
$id: http://devicetree.org/schemas/media/i2c/sony,imx179.yaml#
$schema: http://devicetree.org/meta-schemas/core.yaml#

title: Sony IMX179 8Mpixel CMOS Digital Image Sensor

maintainers:
  - Timothy Schmidt <timschmidt@gmail.com>

description:
  The Sony IMX179 is a CMOS active pixel digital image sensor with an active
  array size of 3280H x 2464V. It is programmable through I2C at address 0x10
  and sends image data through four MIPI CSI-2 data lanes.

allOf:
  - $ref: /schemas/media/video-interface-devices.yaml#

properties:
  compatible:
    const: sony,imx179

  reg:
    maxItems: 1

  clocks:
    description: Input clock, 24 MHz.
    maxItems: 1

  dovdd-supply:
    description: Digital I/O voltage supply, 1.8 volts.

  avdd-supply:
    description: Analogue voltage supply, 2.8 volts.

  dvdd-supply:
    description: Digital core voltage supply, 1.2 volts.

  reset-gpios:
    maxItems: 1
    description: Reference to the GPIO connected to the XCLR pin.

  port:
    $ref: /schemas/graph.yaml#/$defs/port-base
    additionalProperties: false

    properties:
      endpoint:
        $ref: /schemas/media/video-interfaces.yaml#
        unevaluatedProperties: false

        properties:
          data-lanes:
            items:
              - const: 1
              - const: 2
              - const: 3
              - const: 4

          link-frequencies: true

        required:
          - data-lanes
          - link-frequencies

required:
  - compatible
  - reg
  - clocks
  - dovdd-supply
  - avdd-supply
  - dvdd-supply
  - reset-gpios
  - port

unevaluatedProperties: false

examples:
  - |
    #include <dt-bindings/gpio/gpio.h>

    i2c {
        #address-cells = <1>;
        #size-cells = <0>;

        sensor@10 {
            compatible = "sony,imx179";
            reg = <0x10>;
            clocks = <&cam_mclk0>;
            dovdd-supply = <&vreg_1v8>;
            avdd-supply = <&vreg_2v8>;
            dvdd-supply = <&vreg_1v2>;
            reset-gpios = <&tlmm 114 GPIO_ACTIVE_LOW>;

            port {
                endpoint {
                    remote-endpoint = <&csiphy0_ep>;
                    data-lanes = <1 2 3 4>;
                    link-frequencies = /bits/ 64 <324000000>;
                };
            };
        };
    };
...
```

## Documentation/devicetree/bindings/power/avs/qcom,cpr.yaml
```yaml
# SPDX-License-Identifier: (GPL-2.0-only OR BSD-2-Clause)
%YAML 1.2
---
$id: http://devicetree.org/schemas/power/avs/qcom,cpr.yaml#
$schema: http://devicetree.org/meta-schemas/core.yaml#

title: Qualcomm Core Power Reduction (CPR)

maintainers:
  - Niklas Cassel <nks@flawful.org>

description: |
  CPR (Core Power Reduction) is a technology to reduce core power on a CPU
  or other device. Each OPP of a device corresponds to a "corner" that has
  a range of valid voltages for a particular frequency. While the device is
  running at a particular frequency, CPR monitors dynamic factors such as
  temperature, etc. and suggests adjustments to the voltage to save power
  and meet silicon characteristic requirements.

properties:
  compatible:
    items:
      - enum:
          - qcom,qcs404-cpr
          - qcom,msm8926-cpr
      - const: qcom,cpr

  reg:
    description: Base address and size of the RBCPR register region.
    maxItems: 1

  interrupts:
    maxItems: 1

  clocks:
    minItems: 1
    maxItems: 2

  clock-names:
    minItems: 1
    maxItems: 2

  vdd-apc-supply:
    description: APC regulator supply.

  vdd-mx-supply:
    description: Memory rail dependency of the MSM8926 APC supply.

  '#power-domain-cells':
    const: 0

  operating-points-v2:
    description: |
      A phandle to the OPP table containing the performance states
      supported by the CPR power domain.

  qcom,apcs-syscon:
    $ref: /schemas/types.yaml#/definitions/phandle
    description: |
      MSM8926 APCS syscon containing the CPR reference selector. The driver
      requires bit 0 at offset 0x64 to select the 19.2 MHz XO source.

  acc-syscon:
    $ref: /schemas/types.yaml#/definitions/phandle
    description: A phandle to the syscon used for writing ACC settings.

  nvmem-cells:
    minItems: 3
    maxItems: 13

  nvmem-cell-names:
    minItems: 3
    maxItems: 13

allOf:
  - if:
      properties:
        compatible:
          contains:
            const: qcom,msm8926-cpr
    then:
      properties:
        clocks:
          items:
            - description: Reference clock.
            - description: CPU cluster clock, retained across CPU attachments.
        clock-names:
          items:
            - const: ref
            - const: cpu
        acc-syscon: false
        nvmem-cells:
          items:
            - description: Complete raw CPU/PVS row22 including the uplift selector
            - description: Complete raw primary CPR row138
            - description: Complete raw redundant CPR row139
        nvmem-cell-names:
          items:
            - const: cpu_calibration
            - const: cpr_primary
            - const: cpr_redundant
      required:
        - vdd-mx-supply
        - qcom,apcs-syscon
    else:
      properties:
        clocks:
          items:
            - description: Reference clock.
        clock-names:
          items:
            - const: ref
        vdd-mx-supply: false
        qcom,apcs-syscon: false
        nvmem-cells:
          items:
            - description: Corner 1 quotient offset
            - description: Corner 2 quotient offset
            - description: Corner 3 quotient offset
            - description: Corner 1 initial voltage
            - description: Corner 2 initial voltage
            - description: Corner 3 initial voltage
            - description: Corner 1 quotient
            - description: Corner 2 quotient
            - description: Corner 3 quotient
            - description: Corner 1 ring oscillator
            - description: Corner 2 ring oscillator
            - description: Corner 3 ring oscillator
            - description: Fuse revision

        nvmem-cell-names:
          items:
            - const: cpr_quotient_offset1
            - const: cpr_quotient_offset2
            - const: cpr_quotient_offset3
            - const: cpr_init_voltage1
            - const: cpr_init_voltage2
            - const: cpr_init_voltage3
            - const: cpr_quotient1
            - const: cpr_quotient2
            - const: cpr_quotient3
            - const: cpr_ring_osc1
            - const: cpr_ring_osc2
            - const: cpr_ring_osc3
            - const: cpr_fuse_revision

required:
  - compatible
  - reg
  - interrupts
  - clocks
  - clock-names
  - vdd-apc-supply
  - '#power-domain-cells'
  - operating-points-v2
  - nvmem-cells
  - nvmem-cell-names

additionalProperties: false

examples:
  - |
    #include <dt-bindings/interrupt-controller/arm-gic.h>

    cpr_opp_table: opp-table-cpr {
        compatible = "operating-points-v2-qcom-level";

        cpr_opp1: opp1 {
            opp-level = <1>;
            qcom,opp-fuse-level = <1>;
        };
        cpr_opp2: opp2 {
            opp-level = <2>;
            qcom,opp-fuse-level = <2>;
        };
        cpr_opp3: opp3 {
            opp-level = <3>;
            qcom,opp-fuse-level = <3>;
        };
    };

    power-controller@b018000 {
        compatible = "qcom,qcs404-cpr", "qcom,cpr";
        reg = <0x0b018000 0x1000>;
        interrupts = <0 15 IRQ_TYPE_EDGE_RISING>;
        clocks = <&xo_board>;
        clock-names = "ref";
        vdd-apc-supply = <&pms405_s3>;
        #power-domain-cells = <0>;
        operating-points-v2 = <&cpr_opp_table>;
        acc-syscon = <&tcsr>;

        nvmem-cells = <&cpr_efuse_quot_offset1>,
            <&cpr_efuse_quot_offset2>,
            <&cpr_efuse_quot_offset3>,
            <&cpr_efuse_init_voltage1>,
            <&cpr_efuse_init_voltage2>,
            <&cpr_efuse_init_voltage3>,
            <&cpr_efuse_quot1>,
            <&cpr_efuse_quot2>,
            <&cpr_efuse_quot3>,
            <&cpr_efuse_ring1>,
            <&cpr_efuse_ring2>,
            <&cpr_efuse_ring3>,
            <&cpr_efuse_revision>;
        nvmem-cell-names = "cpr_quotient_offset1",
            "cpr_quotient_offset2",
            "cpr_quotient_offset3",
            "cpr_init_voltage1",
            "cpr_init_voltage2",
            "cpr_init_voltage3",
            "cpr_quotient1",
            "cpr_quotient2",
            "cpr_quotient3",
            "cpr_ring_osc1",
            "cpr_ring_osc2",
            "cpr_ring_osc3",
            "cpr_fuse_revision";
    };
```

## Documentation/devicetree/bindings/power/supply/lg,madai-charge-policy.yaml
```yaml
# SPDX-License-Identifier: GPL-2.0-only OR BSD-2-Clause
%YAML 1.2
---
$id: http://devicetree.org/schemas/power/supply/lg,madai-charge-policy.yaml#
$schema: http://devicetree.org/meta-schemas/core.yaml#

title: LG Fx0 charging policy development interface

maintainers:
  - Timothy Schmidt <timschmidt@gmail.com>

description: |
  Experimental policy child of the Fx0 SMBB charger. The parent remains bound
  with battery charging inhibited while these managed suppliers are unavailable.
  A runtime-identified TOCAD Madai profile and verified firmware charge-inhibit
  handoff are required. The raw thermistor voltage is converted without endpoint
  clamping. These properties are a development proposal, not a stable ABI.

properties:
  compatible:
    const: lg,madai-charge-policy

  io-channels:
    items:
      - description: Raw battery thermistor voltage, processed in millivolts
      - description: Battery voltage sense channel

  io-channel-names:
    items:
      - const: thermistor
      - const: voltage

required:
  - compatible
  - io-channels
  - io-channel-names

additionalProperties: false
```

## Documentation/devicetree/bindings/power/supply/qcom,pm8226-bms.yaml
```yaml
# SPDX-License-Identifier: (GPL-2.0-only OR BSD-2-Clause)
%YAML 1.2
---
$id: http://devicetree.org/schemas/power/supply/qcom,pm8226-bms.yaml#
$schema: http://devicetree.org/meta-schemas/core.yaml#

title: Qualcomm PM8226 battery measurement system

maintainers:
  - Sebastian Reichel <sre@kernel.org>

description: |
  The non-VM BMS measures battery sense voltage and integrates a signed
  36-bit coulomb counter. It shares analog calibration with the primary
  IADC. The companion IADC controls the external sense input; battery
  voltage and optional temperature measurements are supplied through IIO.

allOf:
  - $ref: power-supply.yaml#

properties:
  compatible:
    const: qcom,pm8226-bms

  reg:
    items:
      - description: BMS peripheral base in the SPMI register map
      - description: Companion IADC peripheral base
      - description: Battery presence status register

  reg-names:
    items:
      - const: bms
      - const: iadc
      - const: battery-present

  io-channels:
    minItems: 4
    items:
      - description: External current-sense ADC channel
      - description: Gain calibration reference channel
      - description: External zero-current reference channel
      - description: Battery voltage channel
      - description: Battery temperature channel

  io-channel-names:
    minItems: 4
    items:
      - const: current
      - const: gain
      - const: offset
      - const: voltage
      - const: temperature

  shunt-resistor-micro-ohms:
    description: Resistance of the external battery-current shunt
    minimum: 1

  power-supplies: true

  monitored-battery: true

required:
  - compatible
  - reg
  - reg-names
  - io-channels
  - io-channel-names
  - shunt-resistor-micro-ohms

additionalProperties: false

examples:
  - |
    pmic {
        #address-cells = <1>;
        #size-cells = <0>;

        battery@4000 {
            compatible = "qcom,pm8226-bms";
            reg = <0x4000>, <0x3800>, <0x1208>;
            reg-names = "bms", "iadc", "battery-present";
            io-channels = <&iadc 1>, <&iadc 3>, <&iadc 5>, <&vadc 6>;
            io-channel-names = "current", "gain", "offset", "voltage";
            shunt-resistor-micro-ohms = <10800>;
            power-supplies = <&charger>;
        };
    };
```

## drivers/pmdomain/qcom/Kconfig
```kconfig
# SPDX-License-Identifier: GPL-2.0-only
menu "Qualcomm PM Domains"

config QCOM_CPR
	tristate "QCOM Core Power Reduction (CPR) support"
	depends on ARCH_QCOM && HAS_IOMEM
	select PM_OPP
	select REGMAP
	help
	  Say Y here to enable support for the CPR hardware found on Qualcomm
	  SoCs like QCS404.

	  This driver populates CPU OPPs tables and makes adjustments to the
	  tables based on feedback from the CPR hardware. If you want to do
	  CPUfrequency scaling say Y here.

	  To compile this driver as a module, choose M here: the module will
	  be called qcom-cpr

config QCOM_CPR_MSM8926
	bool "MSM8926 CPR calibration and CPU domain support"
	depends on QCOM_CPR=y && QCOM_SCM=y
	help
	  Use the MSM8926 raw and secure calibration rows and the PM8226 fixed
	  boot-range APC regulator. This CPU rail remains powered independently
	  of domain state, so its MX dependency is retained for the driver lifetime.
	  This support must be built in and has no manual bind/unbind interface.
	  Board description, CPU domain attachment and OPP eligibility are required
	  separately. Only suspend-to-idle retains the active-only MX vote; deeper
	  suspend is rejected until an RPM sleep-state handoff is implemented.

config QCOM_RPMHPD
	tristate "Qualcomm RPMh Power domain driver"
	depends on QCOM_RPMH && QCOM_COMMAND_DB
	help
	  QCOM RPMh Power domain driver to support power-domains with
	  performance states. The driver communicates a performance state
	  value to RPMh which then translates it into corresponding voltage
	  for the voltage rail.

config QCOM_RPMPD
	tristate "Qualcomm RPM Power domain driver"
	depends on PM && OF
	depends on QCOM_SMD_RPM
	select PM_GENERIC_DOMAINS
	select PM_GENERIC_DOMAINS_OF
	help
	  QCOM RPM Power domain driver to support power-domains with
	  performance states. The driver communicates a performance state
	  value to RPM which then translates it into corresponding voltage
	  for the voltage rail.

endmenu
```
