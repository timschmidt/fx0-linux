// SPDX-License-Identifier: BSD-3-Clause
/*
 * Copyright (c) 2024, Masanori Ogino <mogino@acm.org>
 */

/dts-v1/;

#include "qcom-msm8226.dtsi"
#include "pm8226.dtsi"
#include <dt-bindings/gpio/gpio.h>
#include <dt-bindings/input/input.h>
#include <dt-bindings/leds/common.h>
#include <dt-bindings/media/video-interfaces.h>

/delete-node/ &smem_region;

/ {
	model = "LG Fx0";
	compatible = "lg,madai", "qcom,msm8926", "qcom,msm8226";
	chassis-type = "handset";

	aliases {
		mmc0 = &sdhc_1; /* SDC1 eMMC slot */
		mmc1 = &sdhc_2; /* SDC2 SD card slot */
		serial0 = &blsp1_uart3;
	};

	chosen {
		stdout-path = "serial0";
	};

	gpio-keys {
		compatible = "gpio-keys";
		pinctrl-0 = <&gpio_keys_default>;
		pinctrl-1 = <&gpio_keys_sleep>;
		pinctrl-names = "default", "sleep";

		button-volume-down {
			label = "Volume Down";
			gpios = <&tlmm 106 GPIO_ACTIVE_LOW>;
			linux,code = <KEY_VOLUMEDOWN>;
			debounce-interval = <15>;
			wakeup-source;
		};

		button-home {
			label = "Home";
			gpios = <&tlmm 107 GPIO_ACTIVE_LOW>;
			linux,code = <KEY_HOME>;
			debounce-interval = <15>;
			wakeup-source;
		};

		button-volume-up {
			label = "Volume Up";
			gpios = <&tlmm 108 GPIO_ACTIVE_LOW>;
			linux,code = <KEY_VOLUMEUP>;
			debounce-interval = <15>;
			wakeup-source;
		};
	};

	cam_avdd: regulator-camera-avdd {
		compatible = "regulator-fixed";
		regulator-name = "cam_avdd_2v8";
		regulator-min-microvolt = <2800000>;
		regulator-max-microvolt = <2800000>;
		gpio = <&tlmm 110 GPIO_ACTIVE_HIGH>;
		enable-active-high;
		startup-delay-us = <1000>;
	};

	cam_vio: regulator-camera-io {
		compatible = "regulator-fixed";
		regulator-name = "cam_io_1v8";
		regulator-min-microvolt = <1800000>;
		regulator-max-microvolt = <1800000>;
		gpio = <&tlmm 64 GPIO_ACTIVE_HIGH>;
		enable-active-high;
		startup-delay-us = <1000>;
		off-on-delay-us = <10000>;
	};

	reserved-memory {
		/* Stock firmware excludes 5 MiB here; the first MiB is SMEM. */
		reserved@fb00000 {
			reg = <0x0fb00000 0x400000>;
			no-map;
		};

		smem_region: smem@fa00000 {
			reg = <0x0fa00000 0x100000>;
			no-map;
		};
	};
};

&tlmm {
	cam_mclk0_default: cam-mclk0-default-state {
		pins = "gpio26";
		function = "cam_mclk0";
		drive-strength = <2>;
		bias-disable;
	};

	gpio_keys_default: gpio-keys-default-state {
		pins = "gpio106", "gpio107", "gpio108";
		function = "gpio";
		drive-strength = <2>;
		bias-pull-up;
	};

	gpio_keys_sleep: gpio-keys-sleep-state {
		pins = "gpio106", "gpio107", "gpio108";
		function = "gpio";
		drive-strength = <2>;
		bias-disable;
	};

	sdhc2_cd_default: sdhc2-cd-default-state {
		pins = "gpio37";
		function = "gpio";
		drive-strength = <2>;
		bias-pull-up;
	};

	wcnss_pin_a: wcnss-pin-active-state {
		pins = "gpio40", "gpio41", "gpio42", "gpio43", "gpio44";
		function = "wlan";
		drive-strength = <6>;
		bias-pull-down;
	};
};

&cci {
	status = "okay";
};

&adsp {
	status = "okay";
};

&blsp1_uart3 {
	status = "okay";
};

&mba_region {
	status = "okay";
};

&mpss_region {
	status = "okay";
};

&pm8226_vadc {
	channel@6 {
		reg = <VADC_VBAT_SNS>;
		label = "vbat_sns";
	};

	channel@30 {
		reg = <VADC_LR_MUX1_BAT_THERM>;
		label = "batt_therm";
		qcom,ratiometric;
		qcom,hw-settle-time = <200>;
	};
};

&pronto {
	vddmx-supply = <&pm8226_l3>;
	vddpx-supply = <&pm8226_l6>;

	pinctrl-0 = <&wcnss_pin_a>;
	pinctrl-names = "default";

	status = "okay";

	iris {
		compatible = "qcom,wcn3660";

		vddxo-supply = <&pm8226_l10>;
		vddrfa-supply = <&pm8226_l24>;
		vddpa-supply = <&pm8226_l16>;
		vdddig-supply = <&pm8226_l24>;
	};

	smd-edge {
		wcnss {
			status = "okay";
		};
	};
};

&rpm_requests {
	regulators {
		compatible = "qcom,rpm-pm8226-regulators";

		pm8226_l3: l3 {
			regulator-min-microvolt = <750000>;
			regulator-max-microvolt = <1337500>;
		};

		pm8226_l18: l18 {
			regulator-min-microvolt = <2950000>;
			regulator-max-microvolt = <2950000>;
			regulator-allow-set-load;
		};

		pm8226_l21: l21 {
			regulator-min-microvolt = <1800000>;
			regulator-max-microvolt = <2950000>;
			regulator-allow-set-load;
		};

		pm8226_l4: l4 {
			regulator-min-microvolt = <1200000>;
			regulator-max-microvolt = <1200000>;
			regulator-allow-set-load;
		};

		pm8226_l6: l6 {
			regulator-min-microvolt = <1800000>;
			regulator-max-microvolt = <1800000>;
			regulator-always-on;
			regulator-allow-set-load;
		};

		pm8226_l8: l8 {
			regulator-min-microvolt = <1800000>;
			regulator-max-microvolt = <1800000>;
			/* Also supplies the CPU PLL. */
			regulator-always-on;
			regulator-allow-set-load;
		};

		pm8226_l10: l10 {
			regulator-min-microvolt = <1800000>;
			regulator-max-microvolt = <1800000>;
		};

		pm8226_l16: l16 {
			regulator-min-microvolt = <3000000>;
			regulator-max-microvolt = <3350000>;
		};

		pm8226_l17: l17 {
			regulator-min-microvolt = <2950000>;
			regulator-max-microvolt = <2950000>;
			regulator-always-on;
			regulator-allow-set-load;
		};

		pm8226_l19: l19 {
			regulator-min-microvolt = <2850000>;
			regulator-max-microvolt = <2850000>;
		};

		pm8226_l20: l20 {
			regulator-min-microvolt = <3075000>;
			regulator-max-microvolt = <3075000>;
		};

		/* Shared by the Iris RFA and digital supplies. */
		pm8226_l24: l24 {
			regulator-min-microvolt = <1300000>;
			regulator-max-microvolt = <1350000>;
		};

		pm8226_l26: l26 {
			regulator-min-microvolt = <1200000>;
			regulator-max-microvolt = <1200000>;
		};

		pm8226_l28: l28 {
			regulator-min-microvolt = <3100000>;
			regulator-max-microvolt = <3100000>;
			regulator-allow-set-load;
		};

		pm8226_lvs1: lvs1 {
			/* The sensor bus answers about 5 ms after the switch closes. */
			regulator-enable-ramp-delay = <10000>;
		};
	};
};

&sdhc_1 {
	vmmc-supply = <&pm8226_l17>;
	vqmmc-supply = <&pm8226_l6>;

	bus-width = <8>;
	non-removable;
	max-frequency = <200000000>;
	mmc-hs200-1_8v;
	mmc-ddr-1_8v;

	status = "okay";
};

&smbb {
	qcom,fast-charge-safe-current = <1500000>;
	qcom,fast-charge-current-limit = <1200000>;
	qcom,fast-charge-safe-voltage = <4380000>;
	qcom,fast-charge-high-threshold-voltage = <4350000>;
	qcom,auto-recharge-threshold-voltage = <4280000>;
	qcom,minimum-input-voltage = <4350000>;

	status = "okay";
};

&usb {
	extcon = <&smbb>;
	dr_mode = "peripheral";
	status = "okay";
};

&usb_hs_phy {
	extcon = <&smbb>;
	v1p8-supply = <&pm8226_l10>;
	v3p3-supply = <&pm8226_l20>;
};

&blsp1_i2c5 {
	status = "okay";

	touchscreen@20 {
		compatible = "syna,rmi4-i2c";
		reg = <0x20>;
		interrupt-parent = <&tlmm>;
		interrupts = <17 IRQ_TYPE_EDGE_FALLING>;
		reset-gpios = <&tlmm 16 GPIO_ACTIVE_LOW>;
		vdd-supply = <&pm8226_l28>;
		vio-supply = <&pm8226_l6>;
		syna,startup-delay-ms = <60>;
		#address-cells = <1>;
		#size-cells = <0>;

		rmi4-f01@1 {
			reg = <0x01>;
			syna,nosleep-mode = <2>;
		};

		rmi4-f12@12 {
			reg = <0x12>;
			syna,sensor-type = <1>;
			touchscreen-inverted-x;
			touchscreen-inverted-y;
		};
	};
};

&mdss {
	status = "okay";
};

&mdss_dsi0 {
	vdd-supply = <&pm8226_l28>;
	vdda-supply = <&pm8226_l4>;
	vddio-supply = <&pm8226_l8>;

	panel@0 {
		compatible = "lg,fx0-panel";
		reg = <0>;
		vdd-supply = <&pm8226_l28>;
		reset-gpios = <&tlmm 25 GPIO_ACTIVE_LOW>;
		io-enable-gpios = <&tlmm 113 GPIO_ACTIVE_HIGH>;
		positive-enable-gpios = <&tlmm 111 GPIO_ACTIVE_HIGH>;
		negative-enable-gpios = <&tlmm 112 GPIO_ACTIVE_HIGH>;
		backlight = <&pm8226_wled>;

		port {
			panel_in: endpoint {
				remote-endpoint = <&mdss_dsi0_out>;
			};
		};
	};
};

&mdss_dsi0_out {
	remote-endpoint = <&panel_in>;
};

&mdss_dsi0_phy {
	vddio-supply = <&pm8226_l8>;
};

&pm8226_1 {
	pm8226_wled: wled@d800 {
		compatible = "qcom,pm8941-wled";
		reg = <0xd800>;
		label = "backlight";
		qcom,cs-out;
		qcom,current-limit = <20>;
		qcom,current-boost-limit = <805>;
		qcom,switching-freq = <800>;
		qcom,ovp = <35>;
		qcom,enabled-strings = <0>;
		default-brightness = <512>;
	};
};

&gpu {
	status = "okay";
};

&gpu_iommu {
	status = "okay";
};

&mdp_iommu {
	status = "okay";
};

&mdss_mdp {
	iommus = <&mdp_iommu 0>;
};

/*
 * The stock bootloader consumes the IMEM restart reason before lk2nd runs.
 * Also store the reason in the PON spare register, which it leaves intact.
 */
&pm8226_pon {
	mode-recovery = <0x1>;
	mode-bootloader = <0x2>;
};

&sdhc_2 {
	vmmc-supply = <&pm8226_l18>;
	vqmmc-supply = <&pm8226_l21>;
	bus-width = <4>;
	cd-gpios = <&tlmm 37 GPIO_ACTIVE_LOW>;
	pinctrl-0 = <&sdhc2_default_state>, <&sdhc2_cd_default>;

	status = "okay";
};

&blsp1_i2c2 {
	status = "okay";

	magnetometer@c {
		compatible = "alps,hscdtd008a";
		reg = <0x0c>;
		avdd-supply = <&pm8226_l19>;
		dvdd-supply = <&pm8226_lvs1>;
	};

	imu@68 {
		compatible = "invensense,mpu6515";
		reg = <0x68>;
		interrupts-extended = <&tlmm 69 IRQ_TYPE_EDGE_RISING>;
		vddio-supply = <&pm8226_lvs1>;
	};
};

&pm8226_vib {
	status = "okay";
};

&pm8226_flash {
	status = "okay";

	led {
		function = LED_FUNCTION_TORCH;
		color = <LED_COLOR_ID_WHITE>;
		led-max-microamp = <200000>;
	};
};

&camss {
	vdda-supply = <&pm8226_l4>;
	status = "okay";

	ports {
		port@0 {
			reg = <0>;

			camss_csiphy0_ep: endpoint {
				remote-endpoint = <&rear_camera_ep>;
				data-lanes = <0 2 3 4>;
				bus-type = <MEDIA_BUS_TYPE_CSI2_DPHY>;
			};
		};
	};
};

&cci_i2c0 {
	rear_camera: camera@10 {
		compatible = "sony,imx179";
		reg = <0x10>;
		clocks = <&mmcc CAMSS_MCLK0_CLK>;
		assigned-clocks = <&mmcc CAMSS_MCLK0_CLK>;
		assigned-clock-rates = <24000000>;
		pinctrl-0 = <&cam_mclk0_default>;
		pinctrl-names = "default";
		dovdd-supply = <&cam_vio>;
		avdd-supply = <&cam_avdd>;
		dvdd-supply = <&pm8226_l26>;
		reset-gpios = <&tlmm 114 GPIO_ACTIVE_LOW>;

		port {
			rear_camera_ep: endpoint {
				remote-endpoint = <&camss_csiphy0_ep>;
				data-lanes = <1 2 3 4>;
				link-frequencies = /bits/ 64 <324000000>;
			};
		};
	};
};

&vfe_iommu {

&apr {
	status = "okay";
};
